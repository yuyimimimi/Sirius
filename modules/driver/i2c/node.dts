
i2c_dev = {
     i2c@1 = {
        status  = "okey";
         name = "i2c-1";
         port = <0>;
        freq_hz = <100000>;
        sda_io = <5>;
        scl_io = <4>;
        rx_buf_enable = <0>;
        tx_buf_enable = <0>;
        buffer_size = <4096>;
        timeout_ms = <200>;
        retrans_times = <0>;
    };
    i2c@2 = {
        status        = "Disable";
        name          = "i2c-2";
        port          = <1>;
        freq_hz       = <100000>;
        sda_io        = <6>;
        scl_io        = <8>;
        rx_buf_enable = <0>;
        tx_buf_enable = <0>;
        buffer_size   = <4096>;
        timeout_ms    = <200>;
        retrans_times = <0>;
    };
};
